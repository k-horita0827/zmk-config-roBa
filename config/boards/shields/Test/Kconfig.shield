## config/boards/shields/Test/Kconfig.shield
```kconfig
config SHIELD_ROBA_R
    def_bool $(shields_list_contains,roBa_R)

config SHIELD_ROBA_L
    def_bool $(shields_list_contains,roBa_L)

config PMW3610_ADJUSTABLE_MOUSESPEED
    bool "Enable adjustable mouse speed for PMW3610"
    default n

config PMW3610_SCROLL_ACCELERATION
    bool "Enable scroll acceleration for PMW3610"
    default n

config PMW3610_SCROLL_ACCELERATION_SENSITIVITY
    int "Scroll acceleration sensitivity"
    depends on PMW3610_SCROLL_ACCELERATION
    range 1 10
    default 3
```
